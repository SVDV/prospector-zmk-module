## Kconfig
```kconfig
config PROSPECTOR_LAYER_ROLLER_ALL_CAPS
    bool "Convert layer names to all caps"
    default n

config PROSPECTOR_ROTATE_DISPLAY_180
    bool "Rotate the display 180 degrees"
    default n

config PROSPECTOR_SHOW_MODIFIERS
    bool "Display modifier key indicators (Cmd, Opt, Ctrl, Shift)"
    default y

config PROSPECTOR_USE_AMBIENT_LIGHT_SENSOR
    bool "Use ambient light sensor for auto brightness"
    default y

config PROSPECTOR_DEFAULT_BRIGHTNESS
    int "Default display brightness (1-100)"
    default 50
    range 1 100

config PROSPECTOR_BRIGHTNESS_STEP
    int "Brightness step for increment/decrement"
    default 10
    range 1 50

config PROSPECTOR_TOUCH_ENABLED
    bool "Enable touch panel for swipe brightness control and view switching"
    default y

choice PROSPECTOR_THEME
    prompt "Display colour theme"
    default PROSPECTOR_THEME_ORIGINAL

config PROSPECTOR_THEME_ORIGINAL
    bool "Original (black background, grey and white)"

config PROSPECTOR_THEME_CATPPUCCIN_MOCHA
    bool "Catppuccin Mocha"

endchoice

choice PROSPECTOR_SWIPE_LAYOUT
    prompt "Which swipe axis switches views"
    default PROSPECTOR_SWIPE_VIEWS_HORIZONTAL
    help
      Directions are as seen on the landscape screen. The other axis changes brightness.

config PROSPECTOR_SWIPE_VIEWS_HORIZONTAL
    bool "Left/right switches views, up/down changes brightness"

config PROSPECTOR_SWIPE_VIEWS_VERTICAL
    bool "Up/down switches views, left/right changes brightness"

endchoice

config PROSPECTOR_VIEW_LIVE_MAP
    bool "Live map view: key heat map and left/right balance"
    default y
    help
      Draws the keyboard from its zmk,physical-layout, which must be included in the dongle's
      devicetree.

config PROSPECTOR_LIVE_MAP_IDLE_RESET_MIN
    int "Start a new live map session after this many idle minutes (0 = only on reboot)"
    default 30
    range 0 1440
    depends on PROSPECTOR_VIEW_LIVE_MAP

config PROSPECTOR_VIEW_GAUGE
    bool "WPM gauge view"
    default y
    imply ZMK_WPM
```

## dts/bindings/behaviors/zmk,behavior-display-brightness.yaml
```yaml
description: Display brightness control behavior

compatible: "zmk,behavior-display-brightness"

include: two_param.yaml
```
